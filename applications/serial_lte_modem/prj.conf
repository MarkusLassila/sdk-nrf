## CMakeLists.txt
```
#
# Copyright (c) 2019 Nordic Semiconductor
#
# SPDX-License-Identifier: LicenseRef-Nordic-5-Clause
#

cmake_minimum_required(VERSION 3.20.0)

find_package(Zephyr REQUIRED HINTS $ENV{ZEPHYR_BASE})
project(serial_lte_modem)

# NORDIC SDK APP START
target_sources(app PRIVATE src/main.c)
target_sources(app PRIVATE src/slm_util.c)
target_sources(app PRIVATE src/slm_settings.c)
target_sources(app PRIVATE src/slm_at_host.c)
target_sources(app PRIVATE src/slm_at_commands.c)
target_sources(app PRIVATE src/slm_at_socket.c)
target_sources(app PRIVATE src/slm_at_tcp_proxy.c)
target_sources(app PRIVATE src/slm_at_udp_proxy.c)
target_sources(app PRIVATE src/slm_at_icmp.c)
target_sources(app PRIVATE src/slm_at_fota.c)
target_sources(app PRIVATE src/slm_uart_handler.c)
# NORDIC SDK APP END
target_sources_ifdef(CONFIG_SLM_SMS app PRIVATE src/slm_at_sms.c)
target_sources_ifdef(CONFIG_SLM_PPP app PRIVATE src/slm_ppp.c)

add_subdirectory_ifdef(CONFIG_SLM_GNSS src/gnss)
add_subdirectory_ifdef(CONFIG_SLM_NRF_CLOUD src/nrfcloud)
add_subdirectory_ifdef(CONFIG_SLM_MQTTC src/mqtt_c)
add_subdirectory_ifdef(CONFIG_SLM_HTTPC src/http_c)
add_subdirectory_ifdef(CONFIG_SLM_TWI src/twi)
add_subdirectory_ifdef(CONFIG_SLM_GPIO src/gpio)
add_subdirectory_ifdef(CONFIG_SLM_CARRIER src/lwm2m_carrier)
add_subdirectory_ifdef(CONFIG_SLM_NATIVE_TLS src/nativetls)
if (CONFIG_SLM_FTPC OR CONFIG_SLM_TFTPC)
        add_subdirectory(src/ftp_c)
endif()

zephyr_include_directories(src)
```

## Kconfig
```
#
# Copyright (c) 2019 Nordic Semiconductor
#
# SPDX-License-Identifier: LicenseRef-Nordic-5-Clause
#

source "Kconfig.zephyr"

menu "Nordic Serial LTE Modem"

config SLM_CUSTOMER_VERSION
	string "Customer version string"
	help
	   This version is reported together with baseline versions by AT command "#XSLMVER".

config SLM_AT_MAX_PARAM
	int "Maximum number of parameters in AT command"
	default 42

#
# external XTAL for UART
#
config SLM_EXTERNAL_XTAL
	bool "Use external XTAL for UARTE"
	default y

#
# AT command terminator
#
choice
	prompt "Termination mode"
	default SLM_CR_LF_TERMINATION
	help
		Sets the command terminator used by the serial terminal.
		Available options are:
		-  CR termination
		-  LF termination
		-  CR+LF termination
	config SLM_CR_TERMINATION
		bool "CR termination"
	config SLM_LF_TERMINATION
		bool "LF termination"
	config SLM_CR_LF_TERMINATION
		bool "CR+LF termination"
endchoice

#
# UART buffers
#
config SLM_UART_RX_BUF_COUNT
	int "Receive buffers for UART"
	range 2 4
	default 3
	help
	  Amount of buffers for receiving (RX) UART traffic. If the buffers are full, UART RX will be disabled until the buffers are processed.

config SLM_UART_RX_BUF_SIZE
	int "Receive buffer size for UART"
	range 128 4096
	default 256
	help
	  Amount of received (RX), unprocessed, UART traffic that can be held by single buffer.

config SLM_UART_TX_BUF_SIZE
	int "Send buffer size for UART"
	range 128 4096
	default 256
	help
	  Amount of UART traffic waiting to be sent (TX), that can be held. If the buffers are full, will send synchronously.

#
# GPIO wakeup
#
config SLM_START_SLEEP
	bool "Enter sleep on startup"
	help
	  Put nRF9160 into deep sleep mode after startup.

config SLM_WAKEUP_PIN
	int "Wakeup pin"
	default -1
	help
	  Interface GPIO to wake up from sleep or exit idle

config SLM_INDICATE_PIN
	int "Indicate pin"
	default -1
	help
	  Interface GPIO pin used to indicate that data is available or an unexpected reset has occurred

config SLM_INDICATE_TIME
	int "Indication period"
	default 100
	help
	  GPIO active indication time in milliseconds. This setting specify the period length for the pin to be active

#
# LTE network automatic attach
#
config SLM_AUTO_CONNECT
	bool "Automatically connect to the LTE network on start-up or after a reset"
	help
	  Enables automatic connection to the LTE network using the PDN configuration defined in 'slm_auto_connect.h'.

#
# TCP/TLS proxy
#
config SLM_TCP_POLL_TIME
	int "Poll time-out in seconds for TCP connection"
	default 10

config SLM_UDP_POLL_TIME
	int "Poll time-out in seconds for UDP connection"
	default 10

#
# Data mode
#
config SLM_DATAMODE_TERMINATOR
	string "Pattern string to terminate data mode"
	default "+++"
	help
	  Use a pattern to terminate data mode

config SLM_DATAMODE_URC
	bool "Send URC in data mode"
	help
	  Report result of data mode sending

config SLM_DATAMODE_BUF_SIZE
	int "Buffer size for data mode"
	range 1024 8192
	default 4096
	help
	  Size of the buffer for data received in data mode.

#
# Configurable services
#
config SLM_SMS
	bool "SMS support in SLM"
	default y
	select SMS
	help
	  Support SMS send/receive in plain text

config SLM_GNSS
	bool "GNSS support in SLM"
	default y

config SLM_NRF_CLOUD
	bool "nRF Cloud support in SLM"
	default y

config SLM_FULL_FOTA
	bool "Full modem FOTA support in SLM"
	default n
	depends on !BOARD_THINGY91_NRF9160_NS

config SLM_PPP
	bool "PPP support in SLM"
	help
	  When enabled, SLM automatically brings up/down the PPP link
	  when the LTE link (default PDN) is connected/disconnected,
	  regardless of what is done with AT#XPPP.

rsource "src/ftp_c/Kconfig"
rsource "src/mqtt_c/Kconfig"
rsource "src/http_c/Kconfig"
rsource "src/twi/Kconfig"
rsource "src/gpio/Kconfig"
rsource "src/lwm2m_carrier/Kconfig"
rsource "src/gnss/Kconfig"
rsource "src/nativetls/Kconfig"

module = SLM
module-str = serial modem
source "${ZEPHYR_BASE}/subsys/logging/Kconfig.template.log_config"

endmenu
```

## prj.conf
```kconfig
#
# Copyright (c) 2020 Nordic Semiconductor ASA
#
# SPDX-License-Identifier: LicenseRef-Nordic-5-Clause
#
# General config
CONFIG_LOG=y
CONFIG_LOG_DEFAULT_LEVEL=2
CONFIG_STACK_SENTINEL=y
CONFIG_PICOLIBC_IO_FLOAT=y
CONFIG_RING_BUFFER=y

# Segger RTT
CONFIG_USE_SEGGER_RTT=y
# Where console messages (printk) are output.
# By itself, SLM does not output any.
CONFIG_RTT_CONSOLE=y
CONFIG_UART_CONSOLE=n
# Where SLM logs are output.
CONFIG_LOG_BACKEND_RTT=y
CONFIG_LOG_BACKEND_UART=n

# Network
CONFIG_NETWORKING=y
CONFIG_NET_SOCKETS=y
CONFIG_NET_NATIVE=n

# Modem library
CONFIG_NRF_MODEM_LIB=y
# Align the max FD entry to NRF_MODEM_MAX_SOCKET_COUNT(8)
CONFIG_POSIX_MAX_FDS=8

# Handle modem fault
CONFIG_NRF_MODEM_LIB_ON_FAULT_APPLICATION_SPECIFIC=y

# Use GPIO
CONFIG_GPIO=y
CONFIG_GPIO_NRFX=y

# UART interface
CONFIG_SERIAL=y
CONFIG_UART_USE_RUNTIME_CONFIGURE=y
CONFIG_UART_ASYNC_API=y
CONFIG_NRFX_TIMER2=y

# Stacks and heaps
CONFIG_MAIN_STACK_SIZE=4096
CONFIG_HEAP_MEM_POOL_SIZE=16384
CONFIG_SYSTEM_WORKQUEUE_STACK_SIZE=4096
CONFIG_AT_MONITOR_HEAP_SIZE=4096

# Device power management
CONFIG_PM_DEVICE=y

# FOTA
CONFIG_HTTP_PARSER_URL=y
CONFIG_FOTA_DOWNLOAD=y
CONFIG_FOTA_DOWNLOAD_PROGRESS_EVT=y
CONFIG_DFU_TARGET=y
CONFIG_DOWNLOAD_CLIENT=y
CONFIG_DOWNLOAD_CLIENT_STACK_SIZE=4096
CONFIG_DOWNLOAD_CLIENT_MAX_FILENAME_SIZE=2048
CONFIG_BOOTLOADER_MCUBOOT=y
CONFIG_IMG_MANAGER=y

# FLASH
CONFIG_FLASH=y
CONFIG_FLASH_PAGE_LAYOUT=y
CONFIG_FLASH_MAP=y
CONFIG_STREAM_FLASH=y
CONFIG_MPU_ALLOW_FLASH_WRITE=y
CONFIG_IMG_ERASE_PROGRESSIVELY=y

# Settings
CONFIG_SETTINGS=y
CONFIG_SETTINGS_NVS=y
CONFIG_NVS=y

# Does not reproduce when building from sources, but building from the sources would be
# the only way to get more information from this. Use libmodem 5ccd2d4d if you try this.
#CONFIG_NRF_MODEM_BUILD_FROM_SRC=y

# nRF Cloud
CONFIG_NRF_CLOUD_IPV6=n
CONFIG_NRF_CLOUD_MQTT=y
CONFIG_NRF_CLOUD_FOTA=n
CONFIG_NRF_CLOUD_AGNSS=y
CONFIG_NRF_CLOUD_AGNSS_FILTERED=n
CONFIG_NRF_CLOUD_PGPS=n
CONFIG_NRF_CLOUD_LOCATION=y
CONFIG_NRF_CLOUD_LOG_LEVEL_ERR=y
CONFIG_NRF_CLOUD_GPS_LOG_LEVEL_ERR=y
CONFIG_NRF_CLOUD_CLIENT_ID_SRC_INTERNAL_UUID=y
CONFIG_NRF_CLOUD_WIFI_LOCATION_ENCODE_OPT_MAC_RSSI=y
CONFIG_DATE_TIME=y
CONFIG_MODEM_INFO=y
CONFIG_MODEM_INFO_ADD_DATE_TIME=n

# UUID and JWT
CONFIG_MODEM_JWT=y

# MQTT client
#CONFIG_MQTT_KEEPALIVE=60
CONFIG_MQTT_CLEAN_SESSION=y

# AT command helper libraries
CONFIG_AT_CMD_PARSER=y
CONFIG_AT_MONITOR=y

# Enable logging for the nrfx library
CONFIG_NRFX_IPC_LOG=y


# Disable TF-M logging.
# TF-M log sending will block until remote end is ready, when HWFC is used on UART1.
#CONFIG_TFM_LOG_LEVEL_SILENCE=y
#CONFIG_TFM_LOG_LEVEL_SILENCE=y

#
# SLM-specific configurations
#
CONFIG_SLM_CUSTOMER_VERSION=""
CONFIG_SLM_EXTERNAL_XTAL=n
CONFIG_SLM_START_SLEEP=n
CONFIG_SLM_DATAMODE_URC=n

# debug options
#CONFIG_ASSERT=y
#CONFIG_LOG_BUFFER_SIZE=16384
CONFIG_SLM_LOG_LEVEL_ERR=y
CONFIG_LOG_PRINTK=n
#CONFIG_LOG_MODE_IMMEDIATE=y

# This is made writable, so we can write the registers to flash.
CONFIG_TFM_NRF_NS_STORAGE=y
CONFIG_EXTRA_EXCEPTION_INFO=y

# For using external GNSS antenna
#CONFIG_MODEM_ANTENNA=y
#CONFIG_MODEM_ANTENNA_GNSS_EXTERNAL=y
```

## overlay-native_tls.conf
```kconfig
#
# Copyright (c) 2023 Nordic Semiconductor ASA
#
# SPDX-License-Identifier: LicenseRef-Nordic-5-Clause
#

CONFIG_SLM_NATIVE_TLS=y
# Enable offloading with TLS_NATIVE.
CONFIG_NET_SOCKETS_OFFLOAD_DISPATCHER=y
# Enable legacy crypto support
CONFIG_NRF_SECURITY=y
CONFIG_NORDIC_SECURITY_BACKEND=y
CONFIG_MBEDTLS_PSA_CRYPTO_C=y
# Enable TLS client and server via Mbed TLS library
CONFIG_MBEDTLS=y
CONFIG_MBEDTLS_TLS_LIBRARY=y
CONFIG_MBEDTLS_SSL_SRV_C=y
CONFIG_MBEDTLS_CIPHER=y
# Reserve enough settings space for the certificates
CONFIG_PM_PARTITION_SIZE_SETTINGS_STORAGE=0x4000
# Set maximum TLS contexts.
# Increase also CONFIG_POSIX_MAX_FDS, if you need more TLS contexts.
CONFIG_NET_SOCKETS_TLS_MAX_CONTEXTS=2
CONFIG_POSIX_MAX_FDS=10
# Set packet sizes for incoming and outcoming packets.
# If handshake packet (likely CA chain) or TLS record size exceeds these
# values, increase the corresponding value and the CONFIG_MBEDTLS_HEAP_SIZE.
CONFIG_MBEDTLS_SSL_IN_CONTENT_LEN=4096
CONFIG_MBEDTLS_SSL_OUT_CONTENT_LEN=4096
CONFIG_MBEDTLS_ENABLE_HEAP=y
# Raise to 64000 for two simultaneous TLS connections
CONFIG_MBEDTLS_HEAP_SIZE=36864
# Enable TLS protocol options
CONFIG_NET_SOCKETS_SOCKOPT_TLS=y
CONFIG_NET_SOCKETS_TLS_SET_MAX_FRAGMENT_LENGTH=y
CONFIG_MBEDTLS_SSL_SERVER_NAME_INDICATION=y
# Enable AES
CONFIG_MBEDTLS_AES_C=y
CONFIG_MBEDTLS_CCM_C=y
CONFIG_MBEDTLS_GCM_C=y
CONFIG_MBEDTLS_CIPHER_MODE_CBC=y
CONFIG_MBEDTLS_CIPHER_PADDING_PKCS7=y
# Enable ECC
CONFIG_MBEDTLS_ECP_C=y
CONFIG_PSA_WANT_ECC_SECP_R1_256=y
# Enable ECDSA
CONFIG_MBEDTLS_ECDSA_C=y
CONFIG_PSA_WANT_ALG_ECDSA=y
CONFIG_MBEDTLS_ECDSA_DETERMINISTIC=y
CONFIG_PSA_WANT_ALG_DETERMINISTIC_ECDSA=y
CONFIG_PSA_WANT_KEY_TYPE_ECC_KEY_PAIR=y # dep for DETERMINISTIC_ECDSA
CONFIG_PSA_WANT_ALG_HMAC=y # dep for DETERMINISTIC_ECDSA
# Enable ECDH
CONFIG_MBEDTLS_KEY_EXCHANGE_ECDH_RSA_ENABLED=y
CONFIG_MBEDTLS_ECDH_C=y
CONFIG_PSA_WANT_ALG_ECDH=y
# Enable EDCHE
CONFIG_MBEDTLS_KEY_EXCHANGE_ECDHE_ECDSA_ENABLED=y
CONFIG_MBEDTLS_KEY_EXCHANGE_ECDHE_RSA_ENABLED=y
# Enable RSA
CONFIG_MBEDTLS_KEY_EXCHANGE_RSA_ENABLED=y
CONFIG_PSA_WANT_KEY_TYPE_RSA_PUBLIC_KEY=y
CONFIG_PSA_WANT_RSA_KEY_SIZE_2048=y
CONFIG_PSA_WANT_RSA_KEY_SIZE_4096=y
CONFIG_MBEDTLS_PKCS1_V15=y
CONFIG_MBEDTLS_MPI_MAX_SIZE=512
# Enable SHA
CONFIG_MBEDTLS_SHA256_C=y
CONFIG_MBEDTLS_SHA512_C=y
# Enable PSK key exchange
CONFIG_MBEDTLS_KEY_EXCHANGE_PSK_ENABLED=y

# Disable MBEDTLS modules
CONFIG_MBEDTLS_CTR_DRBG_C=n
CONFIG_MBEDTLS_CHACHA20_C=n
CONFIG_MBEDTLS_POLY1305_C=n
CONFIG_MBEDTLS_DHM_C=n
CONFIG_MBEDTLS_CMAC_C=n
# Disable cipher modes
CONFIG_MBEDTLS_CIPHER_MODE_CTR=n
CONFIG_MBEDTLS_CIPHER_MODE_CFB=n
CONFIG_MBEDTLS_CIPHER_MODE_OFB=n
# Disable key exchange algorithms
CONFIG_MBEDTLS_KEY_EXCHANGE_DHE_PSK_ENABLED=n
CONFIG_MBEDTLS_KEY_EXCHANGE_DHE_RSA_ENABLED=n
# Disable hash functions
CONFIG_MBEDTLS_SHA1_C=n

# Enable Socket Logging for debug
#CONFIG_NET_LOG=y
#CONFIG_NET_SOCKETS_LOG_LEVEL_DBG=y

# Enable Mbed TLS logs
#CONFIG_MBEDTLS_DEBUG=y
#CONFIG_MBEDTLS_DEBUG_C=y
#CONFIG_MBEDTLS_DEBUG_LEVEL=3
```

## src/main.c
```c
/*
 * Copyright (c) 2019 Nordic Semiconductor ASA
 *
 * SPDX-License-Identifier: LicenseRef-Nordic-5-Clause
 */
#include <zephyr/logging/log.h>
#include <zephyr/logging/log_ctrl.h>
#include <zephyr/kernel.h>
#include <assert.h>
#include <stdio.h>
#include <zephyr/drivers/uart.h>
#include <zephyr/drivers/gpio.h>
#include <string.h>
#include <nrf_modem.h>
#include <hal/nrf_gpio.h>
#include <hal/nrf_power.h>
#include <hal/nrf_regulators.h>
#include <modem/nrf_modem_lib.h>
#include <zephyr/dfu/mcuboot.h>
#include <dfu/dfu_target.h>
#include <zephyr/sys/reboot.h>
#include <zephyr/drivers/clock_control.h>
#include <zephyr/drivers/clock_control/nrf_clock_control.h>
#include <net/fota_download.h>
#include "slm_at_host.h"
#include "slm_at_fota.h"
#include "slm_settings.h"
#include "slm_util.h"

LOG_MODULE_REGISTER(slm, CONFIG_SLM_LOG_LEVEL);

#define SLM_WQ_STACK_SIZE	KB(4)
#define SLM_WQ_PRIORITY		K_LOWEST_APPLICATION_THREAD_PRIO
static K_THREAD_STACK_DEFINE(slm_wq_stack_area, SLM_WQ_STACK_SIZE);

static const struct device *gpio_dev = DEVICE_DT_GET(DT_NODELABEL(gpio0));
#if POWER_PIN_IS_ENABLED
static struct gpio_callback gpio_cb;
#else
BUILD_ASSERT(!IS_ENABLED(CONFIG_SLM_START_SLEEP),
	"CONFIG_SLM_START_SLEEP requires CONFIG_SLM_POWER_PIN to be defined.");
#endif
static struct k_work_delayable indicate_work;

struct k_work_q slm_work_q;
static atomic_t callback_wakeup_running;

/* Forward declarations */
static void indicate_wk(struct k_work *work);
static void power_pin_callback_wakeup(const struct device *dev,
				      struct gpio_callback *gpio_callback, uint32_t);

NRF_MODEM_LIB_ON_INIT(lwm2m_init_hook, on_modem_lib_init, NULL);
NRF_MODEM_LIB_ON_DFU_RES(main_dfu_hook, on_modem_dfu_res, NULL);

static void on_modem_lib_init(int ret, void *ctx)
{
	ARG_UNUSED(ctx);

	/** ret: Zero on success, a positive value @em nrf_modem_dfu when executing
	 *  Modem firmware updates, and negative errno on other failures.
	 */
	LOG_INF("lib_modem init: %d", ret);
}

#if defined(CONFIG_NRF_MODEM_LIB_ON_FAULT_APPLICATION_SPECIFIC)
static struct nrf_modem_fault_info modem_fault_info;

static void on_modem_failure(struct k_work *)
{
	int ret;

	rsp_send("\r\n#XMODEM: FAULT,0x%x,0x%x\r\n", modem_fault_info.reason,
		 modem_fault_info.program_counter);

	ret = nrf_modem_lib_shutdown();
	rsp_send("\r\n#XMODEM: SHUTDOWN,%d\r\n", ret);

	ret = nrf_modem_lib_init();
	rsp_send("\r\n#XMODEM: INIT,%d\r\n", ret);
}
K_WORK_DEFINE(modem_failure_work, on_modem_failure);

void nrf_modem_fault_handler(struct nrf_modem_fault_info *fault_info)
{
	modem_fault_info = *fault_info;

	k_work_submit(&modem_failure_work);
}
#endif /* CONFIG_NRF_MODEM_LIB_ON_FAULT_APPLICATION_SPECIFIC */

static int ext_xtal_control(bool xtal_on)
{
	int err = 0;
#if defined(CONFIG_SLM_EXTERNAL_XTAL)
	static struct onoff_manager *clk_mgr;

	if (xtal_on) {
		struct onoff_client cli = {};

		/* request external XTAL for UART */
		clk_mgr = z_nrf_clock_control_get_onoff(CLOCK_CONTROL_NRF_SUBSYS_HF);
		sys_notify_init_spinwait(&cli.notify);
		err = onoff_request(clk_mgr, &cli);
		if (err < 0) {
			LOG_ERR("Clock request failed: %d", err);
			return err;
		}
		while (sys_notify_fetch_result(&cli.notify, &err) < 0) {
			/*empty*/
		}
	} else {
		/* release external XTAL for UART */
		err = onoff_release(clk_mgr);
		if (err < 0) {
			LOG_ERR("Clock release failed: %d", err);
			return err;
		}
	}
#endif

	return err;
}

#if POWER_PIN_IS_ENABLED

static int configure_power_pin_interrupt(gpio_callback_handler_t handler, gpio_flags_t flags)
{
	int err;
	const gpio_pin_t pin = CONFIG_SLM_POWER_PIN;

	/* First disable the previously configured interrupt. Somehow when in idle mode if
	 * the wake-up interrupt is configured to be on an edge the power consumption
	 * drastically increases (3x), which is is why it is configured to be level-triggered.
	 * When entering idle for some reason first disabling the previously edge-level
	 * configured interrupt is also needed to keep the power consumption down.
	 */
	err = gpio_pin_interrupt_configure(gpio_dev, pin, GPIO_INT_DISABLE);
	if (err) {
		LOG_ERR("Failed to configure %s (0x%x) on power pin. (%d)",
			"interrupt", GPIO_INT_DISABLE, err);
	}

	err = gpio_pin_interrupt_configure(gpio_dev, pin, flags);
	if (err) {
		LOG_ERR("Failed to configure %s (0x%x) on power pin. (%d)",
			"interrupt", flags, err);
		return err;
	}

	gpio_init_callback(&gpio_cb, handler, BIT(pin));

	err = gpio_add_callback(gpio_dev, &gpio_cb);
	if (err) {
		LOG_ERR("Failed to configure %s (0x%x) on power pin. (%d)", "callback", flags, err);
		return err;
	}

	LOG_DBG("Configured interrupt (0x%x) on power pin (%u) with handler (%p).",
		flags, pin, (void *)handler);
	return 0;
}

static void slm_enter_sleep_work_fn(struct k_work *)
{
	slm_enter_sleep();
}

static void power_pin_callback_poweroff(const struct device *dev,
					struct gpio_callback *gpio_callback, uint32_t)
{
	static K_WORK_DEFINE(work, slm_enter_sleep_work_fn);

	LOG_INF("Power off triggered.");
	gpio_remove_callback(dev, gpio_callback);
	k_work_submit(&work);
}

#endif /* POWER_PIN_IS_ENABLED */

#if POWER_PIN_IS_ENABLED || INDICATE_PIN_IS_ENABLED

static int configure_gpio(gpio_pin_t pin, gpio_flags_t flags)
{
	const int err = gpio_pin_configure(gpio_dev, pin, flags);

	if (err) {
		LOG_ERR("Failed to configure GPIO pin P0.%d. (%d)", pin, err);
		return err;
	}

	return 0;
}
#endif

static int init_gpios(void)
{
	if (!device_is_ready(gpio_dev)) {
		LOG_ERR("GPIO controller not ready");
		return -ENODEV;
	}

#if POWER_PIN_IS_ENABLED
	if (configure_gpio(CONFIG_SLM_POWER_PIN, GPIO_INPUT | GPIO_PULL_UP | GPIO_ACTIVE_LOW)) {
		return -1;
	}
#endif

#if INDICATE_PIN_IS_ENABLED
	if (configure_gpio(CONFIG_SLM_INDICATE_PIN, GPIO_OUTPUT_INACTIVE | GPIO_ACTIVE_LOW)) {
		return -1;
	}
#endif

	return 0;
}

int slm_indicate(void)
{
	int err = 0;

#if (INDICATE_PIN_IS_ENABLED)
	if (k_work_delayable_is_pending(&indicate_work)) {
		return 0;
	}
	LOG_DBG("Start indicating");
	err = gpio_pin_set(gpio_dev, CONFIG_SLM_INDICATE_PIN, 1);
	if (err) {
		LOG_ERR("GPIO_0 set error: %d", err);
	} else {
		k_work_reschedule(&indicate_work, K_MSEC(CONFIG_SLM_INDICATE_TIME));
	}
#endif
	return err;
}

static void indicate_stop(void)
{
#if (INDICATE_PIN_IS_ENABLED)
	if (gpio_pin_set(gpio_dev, CONFIG_SLM_INDICATE_PIN, 0) != 0) {
		LOG_WRN("GPIO_0 set error");
	}
	LOG_DBG("Stop indicating");
#endif
}

#if POWER_PIN_IS_ENABLED

static void power_pin_callback_enable_poweroff(const struct device *dev,
					       struct gpio_callback *gpio_callback, uint32_t)
{
	LOG_DBG("Enabling the poweroff interrupt shortly...");
	gpio_remove_callback(dev, gpio_callback);

	configure_power_pin_interrupt(power_pin_callback_poweroff, GPIO_INT_EDGE_RISING);
}

static void power_pin_callback_wakeup_work_fn(struct k_work *)
{
	int err;

	LOG_INF("Resuming from idle.");
	if (k_work_delayable_is_pending(&indicate_work)) {
		k_work_cancel_delayable(&indicate_work);
		indicate_stop();
	}

	err = ext_xtal_control(true);
	if (err < 0) {
		LOG_WRN("Failed to enable ext XTAL: %d", err);
	}
	err = slm_at_host_power_on();
	if (err) {
		LOG_ERR("Failed to power on uart: %d. Resetting SLM.", err);
		gpio_remove_callback(gpio_dev, &gpio_cb);
		slm_reset();
		return;
	}

	atomic_set(&callback_wakeup_running, false);
}

static void power_pin_callback_wakeup(const struct device *dev,
				      struct gpio_callback *gpio_callback, uint32_t)
{
	static K_WORK_DEFINE(work, power_pin_callback_wakeup_work_fn);

	/* Prevent level triggered interrupt running this multiple times. */
	if (!atomic_cas(&callback_wakeup_running, false, true)) {
		return;
	}

	LOG_INF("Resuming from idle shortly...");
	gpio_remove_callback(dev, gpio_callback);

	/* Enable the poweroff interrupt only when the pin will be back to a nonactive state. */
	configure_power_pin_interrupt(power_pin_callback_enable_poweroff, GPIO_INT_EDGE_FALLING);

	k_work_submit(&work);
}

void slm_enter_idle(void)
{
	LOG_INF("Entering idle.");
	int err;

	gpio_remove_callback(gpio_dev, &gpio_cb);

	err = configure_power_pin_interrupt(power_pin_callback_wakeup, GPIO_INT_LEVEL_LOW);
	if (err) {
		return;
	}

	err = ext_xtal_control(false);
	if (err < 0) {
		LOG_WRN("Failed to disable ext XTAL: %d", err);
	}
}

static void enter_sleep_no_uninit(void)
{
	LOG_INF("Entering sleep.");
	LOG_PANIC();
	nrf_gpio_cfg_sense_set(CONFIG_SLM_POWER_PIN, NRF_GPIO_PIN_SENSE_LOW);

	k_sleep(K_MSEC(100));

	nrf_regulators_system_off(NRF_REGULATORS_NS);
	assert(false);
}

void slm_enter_sleep(void)
{
	slm_at_host_uninit();

	/* Only power off the modem if it has not been put
	 * in flight mode to allow reducing NVM wear.
	 */
	if (!slm_is_modem_functional_mode(LTE_LC_FUNC_MODE_OFFLINE)) {
		slm_power_off_modem();
	}
	enter_sleep_no_uninit();
}

#endif /* POWER_PIN_IS_ENABLED */

void slm_enter_shutdown(void)
{
	LOG_INF("Entering shutdown.");

	/* De-configure GPIOs */
#if POWER_PIN_IS_ENABLED
	gpio_pin_interrupt_configure(gpio_dev, CONFIG_SLM_POWER_PIN, GPIO_INT_DISABLE);
	gpio_pin_configure(gpio_dev, CONFIG_SLM_POWER_PIN, GPIO_DISCONNECTED);
#endif
#if INDICATE_PIN_IS_ENABLED
	gpio_pin_configure(gpio_dev, CONFIG_SLM_INDICATE_PIN, GPIO_DISCONNECTED);
#endif

	k_sleep(K_MSEC(100));

	nrf_regulators_system_off(NRF_REGULATORS_NS);
	assert(false);
}

static void on_modem_dfu_res(int dfu_res, void *ctx)
{
	slm_fota_type = DFU_TARGET_IMAGE_TYPE_MODEM_DELTA;
	slm_fota_stage = FOTA_STAGE_COMPLETE;
	slm_fota_status = FOTA_STATUS_ERROR;
	slm_fota_info = dfu_res;

	switch (dfu_res) {
	case NRF_MODEM_DFU_RESULT_OK:
		LOG_INF("Modem update OK. Running new firmware.");
		slm_fota_status = FOTA_STATUS_OK;
		slm_fota_info = 0;
		break;
	case NRF_MODEM_DFU_RESULT_UUID_ERROR:
	case NRF_MODEM_DFU_RESULT_AUTH_ERROR:
		LOG_ERR("Modem update failed (0x%x). Running old firmware.", dfu_res);
		break;
	case NRF_MODEM_DFU_RESULT_HARDWARE_ERROR:
	case NRF_MODEM_DFU_RESULT_INTERNAL_ERROR:
		LOG_ERR("Fatal error (0x%x) encountered during modem update.", dfu_res);
		break;
	case NRF_MODEM_DFU_RESULT_VOLTAGE_LOW:
		LOG_ERR("Modem update postponed due to low voltage. "
			"Reset the modem once you have sufficient power.");
		slm_fota_stage = FOTA_STAGE_ACTIVATE;
		break;
	default:
		LOG_ERR("Unhandled nrf_modem DFU result code 0x%x.", dfu_res);
		break;
	}
}

static void check_app_fota_status(void)
{
	/** When a TEST image is swapped to primary partition and booted by MCUBOOT,
	 * the API mcuboot_swap_type() will return BOOT_SWAP_TYPE_REVERT. By this type
	 * MCUBOOT means that the TEST image is booted OK and, if it's not confirmed
	 * next, it'll be swapped back to secondary partition and original application
	 * image will be restored to the primary partition (so-called Revert).
	 */
	const int type = mcuboot_swap_type();

	switch (type) {
	/** Attempt to boot the contents of slot 0. */
	case BOOT_SWAP_TYPE_NONE:
		/* Normal reset, nothing happened, do nothing. */
		return;
	/** Swap to slot 1. Absent a confirm command, revert back on next boot. */
	case BOOT_SWAP_TYPE_TEST:
	/** Swap to slot 1, and permanently switch to booting its contents. */
	case BOOT_SWAP_TYPE_PERM:
	/** Swap failed because image to be run is not valid. */
	case BOOT_SWAP_TYPE_FAIL:
		slm_fota_status = FOTA_STATUS_ERROR;
		slm_fota_info = type;
		break;
	/** Swap back to alternate slot. A confirm changes this state to NONE. */
	case BOOT_SWAP_TYPE_REVERT:
		/* Happens on a successful application FOTA. */
		const int ret = boot_write_img_confirmed();

		slm_fota_info = ret;
		slm_fota_status = ret ? FOTA_STATUS_ERROR : FOTA_STATUS_OK;
		break;
	}
	slm_fota_type = DFU_TARGET_IMAGE_TYPE_MCUBOOT;
	slm_fota_stage = FOTA_STAGE_COMPLETE;
}

int lte_auto_connect(void)
{
	int err = 0;
#if defined(CONFIG_SLM_AUTO_CONNECT)
	int ret;
	int n;
	int stat;
	struct network_config {
		/* Refer to AT command manual of %XSYSTEMMODE for system mode settings */
		int lte_m_support;     /* 0 ~ 1 */
		int nb_iot_support;    /* 0 ~ 1 */
		int gnss_support;      /* 0 ~ 1 */
		int lte_preference;    /* 0 ~ 4 */
		/* Refer to AT command manual of +CGDCONT and +CGAUTH for PDN configuration */
		bool pdp_config;       /* PDP context definition required or not */
		char *pdn_fam;         /* PDP type: "IP", "IPV6", "IPV4V6", "Non-IP" */
		char *pdn_apn;         /* Access point name */
		int pdn_auth;          /* PDN authentication protocol 0(None), 1(PAP), 2(CHAP) */
		char *pdn_username;    /* PDN connection authentication username */
		char *pdn_password;    /* PDN connection authentication password */
	};
	const struct network_config cfg = {
#include "slm_auto_connect.h"
	};

	ret = slm_util_at_scanf("AT+CEREG?", "+CEREG: %d,%d", &n, &stat);
	if (ret != 2 || (stat == 1 || stat == 5)) {
		return 0;
	}

	LOG_INF("lte auto connect");
	err = slm_util_at_printf("AT%%XSYSTEMMODE=%d,%d,%d,%d", cfg.lte_m_support,
				  cfg.nb_iot_support, cfg.gnss_support, cfg.lte_preference);
	if (err) {
		LOG_ERR("Failed to configure system mode: %d", err);
		return err;
	}
	if (cfg.pdp_config) {
		err = slm_util_at_printf("AT+CGDCONT=0,%s,%s", cfg.pdn_fam, cfg.pdn_apn);
		if (err) {
			LOG_ERR("Failed to configure PDN: %d", err);
			return err;
		}
	}
	if (cfg.pdp_config && cfg.pdn_auth != 0) {
		err = slm_util_at_printf("AT+CGAUTH=0,%d,%s,%s", cfg.pdn_auth,
					  cfg.pdn_username, cfg.pdn_password);
		if (err) {
			LOG_ERR("Failed to configure AUTH: %d", err);
			return err;
		}
	}
	err = slm_util_at_printf("AT+CFUN=1");
	if (err) {
		LOG_ERR("Failed to turn on radio: %d", err);
		return err;
	}
#endif /* CONFIG_SLM_AUTO_CONNECT */

	return err;
}

int start_execute(void)
{
	int err;

	LOG_INF("Serial LTE Modem");
	err = ext_xtal_control(true);
	if (err < 0) {
		LOG_ERR("Failed to enable ext XTAL: %d", err);
		return err;
	}
#if POWER_PIN_IS_ENABLED
	/* Do not directly enable the poweroff interrupt so that only a full toggle triggers
	 * power off. This is because power on is triggered on low level, so if the pin is held
	 * down until SLM is fully initialized releasing it would directly trigger the power off.
	 */
	err = configure_power_pin_interrupt(power_pin_callback_enable_poweroff,
					    GPIO_INT_EDGE_FALLING);
	if (err) {
		return err;
	}
#endif
	/* This will send "READY" or "INIT ERROR" to UART so after this nothing
	 * should be done that can fail
	 */
	err = slm_at_host_init();
	if (err) {
		LOG_ERR("Failed to init at_host: %d", err);
		return err;
	}

	k_work_queue_start(&slm_work_q, slm_wq_stack_area,
			   K_THREAD_STACK_SIZEOF(slm_wq_stack_area),
			   SLM_WQ_PRIORITY, NULL);
	(void)lte_auto_connect();

	return 0;
}

static void indicate_wk(struct k_work *work)
{
	ARG_UNUSED(work);

	indicate_stop();
}

int main(void)
{
	const uint32_t rr = nrf_power_resetreas_get(NRF_POWER_NS);

	nrf_power_resetreas_clear(NRF_POWER_NS, 0x70017);
	LOG_DBG("RR: 0x%08x", rr);
	k_work_init_delayable(&indicate_work, indicate_wk);

	if (init_gpios() != 0) {
		LOG_WRN("Failed to init GPIO pins.");
	}
	/* Init and load settings */
	if (slm_settings_init() != 0) {
		LOG_WRN("Failed to init slm settings");
	}

#if defined(CONFIG_SLM_FULL_FOTA)
	if (slm_modem_full_fota) {
		slm_finish_modem_full_fota();
		slm_fota_type = DFU_TARGET_IMAGE_TYPE_FULL_MODEM;
	}
#endif

	int ret = nrf_modem_lib_init();

	if (ret) {
		LOG_ERR("Modem library init failed, err: %d", ret);
		if (ret != -EAGAIN && ret != -EIO) {
			goto exit;
		} else if (ret == -EIO) {
			LOG_ERR("Please program full modem firmware with the bootloader or "
				"external tools");
		}
	}

	check_app_fota_status();

#if defined(CONFIG_SLM_START_SLEEP)

	if (!(rr & NRF_POWER_RESETREAS_OFF_MASK)) { /* DETECT signal from GPIO */

		enter_sleep_no_uninit();
	}
#endif /* CONFIG_SLM_START_SLEEP */

	ret = start_execute();
exit:
	if (ret) {
		LOG_ERR("Failed to start SLM (%d). It's not operational!!!", ret);
	}
	return ret;
}
```

## src/slm_at_commands.c
```c
/*
 * Copyright (c) 2021 Nordic Semiconductor ASA
 *
 * SPDX-License-Identifier: LicenseRef-Nordic-5-Clause
 */
#include <ctype.h>
#include <stdio.h>
#include <string.h>
#include <zephyr/init.h>
#include <zephyr/drivers/uart.h>
#include <zephyr/kernel.h>
#include <zephyr/logging/log_ctrl.h>
#include <zephyr/sys/reboot.h>
#include <zephyr/sys/util.h>
#include <zephyr/types.h>
#include <dfu/dfu_target.h>
#include <modem/at_cmd_parser.h>
#include <modem/lte_lc.h>
#include <modem/modem_jwt.h>
#include <modem/nrf_modem_lib.h>
#include "nrf_modem.h"
#include "ncs_version.h"

#include "slm_util.h"
#include "slm_settings.h"
#include "slm_at_host.h"
#include "slm_at_tcp_proxy.h"
#include "slm_at_udp_proxy.h"
#include "slm_at_socket.h"
#include "slm_at_icmp.h"
#include "slm_at_sms.h"
#include "slm_at_fota.h"
#if defined(CONFIG_SLM_NATIVE_TLS)
#include "slm_at_cmng.h"
#endif
#if defined(CONFIG_SLM_NRF_CLOUD)
#include "slm_at_nrfcloud.h"
#endif
#if defined(CONFIG_SLM_GNSS)
#include "slm_at_gnss.h"
#endif
#if defined(CONFIG_SLM_FTPC)
#include "slm_at_ftp.h"
#endif
#if defined(CONFIG_SLM_MQTTC)
#include "slm_at_mqtt.h"
#endif
#if defined(CONFIG_SLM_HTTPC)
#include "slm_at_httpc.h"
#endif
#if defined(CONFIG_SLM_TWI)
#include "slm_at_twi.h"
#endif
#if defined(CONFIG_SLM_GPIO)
#include "slm_at_gpio.h"
#endif
#if defined(CONFIG_SLM_CARRIER)
#include "slm_at_carrier.h"
#endif
#if defined(CONFIG_LWM2M_CARRIER_SETTINGS)
#include "slm_at_carrier_cfg.h"
#endif
#if defined(CONFIG_SLM_PPP)
#include "slm_ppp.h"
#endif
#if defined(CONFIG_SLM_CMUX)
#include "slm_cmux.h"
#endif

LOG_MODULE_REGISTER(slm_at, CONFIG_SLM_LOG_LEVEL);

/** @brief Shutdown modes. */
enum sleep_modes {
	SLEEP_MODE_INVALID,
	SLEEP_MODE_DEEP,
	SLEEP_MODE_IDLE
};

/** @brief AT command handler type. */
typedef int (*slm_at_handler_t) (enum at_cmd_type);

static struct slm_work_info {
	struct k_work_delayable sleep_work;
	uint32_t data;
} slm_work;

/* global functions defined in different files */
void enter_idle(void);
void enter_sleep(void);
void enter_shutdown(void);
bool verify_datamode_control(uint16_t time_limit, uint16_t *time_limit_min);

/** @return Whether the modem is in the given functional mode. */
static bool is_modem_functional_mode(enum lte_lc_func_mode mode)
{
	int cfun;
	int rc = slm_util_at_scanf("AT+CFUN?", "+CFUN: %d", &cfun);

	return (rc == 1 && cfun == mode);
}

static void modem_power_off(void)
{
	/* First check whether the modem has already been turned off by the MCU. */
	if (!is_modem_functional_mode(LTE_LC_FUNC_MODE_POWER_OFF)) {

		/* "[...] there may be a delay until modem is disconnected from the network."
		 * https://infocenter.nordicsemi.com/topic/ps_nrf9160/chapters/pmu/doc/operationmodes/system_off_mode.html
		 * This will return once the modem responds, which means it has actually
		 * stopped. This has been observed to take between 1 and 2 seconds.
		 */
		slm_util_at_printf("AT+CFUN=0");
	}
}

/* Handles AT#XSLMVER command. */
static int handle_at_slmver(enum at_cmd_type type)
{
	int ret = -EINVAL;

	if (type == AT_CMD_TYPE_SET_COMMAND) {
		char *libmodem = nrf_modem_build_version();

		if (strlen(CONFIG_SLM_CUSTOMER_VERSION) > 0) {
			rsp_send("\r\n#XSLMVER: %s,\"%s\",\"%s\"\r\n",
				 STRINGIFY(NCS_VERSION_STRING), libmodem,
				 CONFIG_SLM_CUSTOMER_VERSION);
		} else {
			rsp_send("\r\n#XSLMVER: %s,\"%s\"\r\n",
				 STRINGIFY(NCS_VERSION_STRING), libmodem);
		}
		ret = 0;
	}

	return ret;
}

static void go_sleep_wk(struct k_work *work)
{
	ARG_UNUSED(work);

	if (slm_work.data == SLEEP_MODE_IDLE) {
		if (slm_at_host_power_off() == 0) {
			enter_idle();
		} else {
			LOG_ERR("failed to power off UART");
		}
	} else if (slm_work.data == SLEEP_MODE_DEEP) {
		slm_at_host_uninit();

		/* Only power off the modem if it has not been put
		 * in flight mode to allow reducing NVM wear.
		 */
		if (!is_modem_functional_mode(LTE_LC_FUNC_MODE_OFFLINE)) {
			modem_power_off();
		}
		LOG_PANIC();
		enter_sleep();
	}
}

/* Handles AT#XSLEEP commands. */
static int handle_at_sleep(enum at_cmd_type type)
{
	int ret = -EINVAL;

	if (type == AT_CMD_TYPE_SET_COMMAND) {
		ret = at_params_unsigned_int_get(&slm_at_param_list, 1, &slm_work.data);
		if (ret) {
			return -EINVAL;
		}
		if (slm_work.data == SLEEP_MODE_DEEP || slm_work.data == SLEEP_MODE_IDLE) {
			k_work_reschedule(&slm_work.sleep_work, K_MSEC(100));
		} else {
			ret = -EINVAL;
		}
	} else if (type == AT_CMD_TYPE_TEST_COMMAND) {
		rsp_send("\r\n#XSLEEP: (%d,%d)\r\n", SLEEP_MODE_DEEP, SLEEP_MODE_IDLE);
		ret = 0;
	}

	return ret;
}

static void final_call(void (*func)(void))
{
	/* Delegate the final call to a worker so that the "OK" response is properly sent. */
	static struct k_work_delayable worker;

	k_work_init_delayable(&worker, (k_work_handler_t)func);
	k_work_schedule(&worker, SLM_UART_RESPONSE_DELAY);
}

static void slm_shutdown(void)
{
	slm_at_host_uninit();
	modem_power_off();
	LOG_PANIC();
	enter_shutdown();
}

/* Handles AT#XSHUTDOWN command. */
static int handle_at_shutdown(enum at_cmd_type type)
{
	if (type != AT_CMD_TYPE_SET_COMMAND) {
		return -EINVAL;
	}
	final_call(slm_shutdown);
	return 0;
}

FUNC_NORETURN void slm_reset(void)
{
	slm_at_host_uninit();
	modem_power_off();
	LOG_PANIC();
	sys_reboot(SYS_REBOOT_COLD);
}

/* Handles AT#XRESET command. */
static int handle_at_reset(enum at_cmd_type type)
{
	// For causing null pointer exception to test that the fatal.c works correctly.
	// int *ptr = NULL;
	// int value = *ptr;
	// printk("value: %d\n", value);

	if (type != AT_CMD_TYPE_SET_COMMAND) {
		return -EINVAL;
	}
	final_call(slm_reset);
	return 0;
}

/* Handles AT#XMODEMRESET command. */
static int handle_at_modemreset(enum at_cmd_type type)
{
	if (type != AT_CMD_TYPE_SET_COMMAND) {
		return -EINVAL;
	}

	/* The modem must be put in minimal function mode before being shut down. */
	modem_power_off();

	unsigned int step = 1;
	int ret;

	ret = nrf_modem_lib_shutdown();
	if (ret != 0) {
		goto out;
	}
	++step;

#if defined(CONFIG_SLM_FULL_FOTA)
	if (slm_modem_full_fota) {
		slm_finish_modem_full_fota();
	}
#endif

	ret = nrf_modem_lib_init();

	if (slm_fota_type & DFU_TARGET_IMAGE_TYPE_ANY_MODEM) {
		slm_fota_post_process();
	}

out:
	if (ret) {
		/* Error; print the step that failed and its error code. */
		rsp_send("\r\n#XMODEMRESET: %u,%d\r\n", step, ret);
		return 0;
	}

	rsp_send("\r\n#XMODEMRESET: 0\r\n");
	return 0;
}

/* Handles AT#XUUID command. */
static int handle_at_uuid(enum at_cmd_type type)
{
	int ret;

	if (type != AT_CMD_TYPE_SET_COMMAND) {
		return -EINVAL;
	}

	struct nrf_device_uuid dev = {0};

	ret = modem_jwt_get_uuids(&dev, NULL);
	if (ret) {
		LOG_ERR("Get device UUID error: %d", ret);
	} else {
		rsp_send("\r\n#XUUID: %s\r\n", dev.str);
	}

	return ret;
}

/* Handles AT#XDATACTRL commands. */
static int handle_at_datactrl(enum at_cmd_type cmd_type)
{
	int ret = 0;
	uint16_t time_limit, time_limit_min;

	switch (cmd_type) {
	case AT_CMD_TYPE_SET_COMMAND:
		ret = at_params_unsigned_short_get(&slm_at_param_list, 1, &time_limit);
		if (ret) {
			return ret;
		}
		if (time_limit > 0 && verify_datamode_control(time_limit, NULL)) {
			slm_datamode_time_limit = time_limit;
		} else {
			return -EINVAL;
		}
		break;

	case AT_CMD_TYPE_READ_COMMAND:
		(void)verify_datamode_control(slm_datamode_time_limit, &time_limit_min);
		rsp_send("\r\n#XDATACTRL: %d,%d\r\n", slm_datamode_time_limit, time_limit_min);
		break;

	case AT_CMD_TYPE_TEST_COMMAND:
		rsp_send("\r\n#XDATACTRL=<time_limit>\r\n");
		break;

	default:
		break;
	}

	return ret;
}

int handle_at_clac(enum at_cmd_type cmd_type);

/* TCP proxy commands */
int handle_at_tcp_server(enum at_cmd_type cmd_type);
int handle_at_tcp_client(enum at_cmd_type cmd_type);
int handle_at_tcp_send(enum at_cmd_type cmd_type);
int handle_at_tcp_hangup(enum at_cmd_type cmd_type);

/* UDP proxy commands */
int handle_at_udp_server(enum at_cmd_type cmd_type);
int handle_at_udp_client(enum at_cmd_type cmd_type);
int handle_at_udp_send(enum at_cmd_type cmd_type);

/* Socket-type TCPIP commands */
int handle_at_socket(enum at_cmd_type cmd_type);
int handle_at_secure_socket(enum at_cmd_type cmd_type);
int handle_at_socket_select(enum at_cmd_type cmd_type);
int handle_at_socketopt(enum at_cmd_type cmd_type);
int handle_at_secure_socketopt(enum at_cmd_type cmd_type);
int handle_at_bind(enum at_cmd_type cmd_type);
int handle_at_connect(enum at_cmd_type cmd_type);
int handle_at_listen(enum at_cmd_type cmd_type);
int handle_at_accept(enum at_cmd_type cmd_type);
int handle_at_send(enum at_cmd_type cmd_type);
int handle_at_recv(enum at_cmd_type cmd_type);
int handle_at_sendto(enum at_cmd_type cmd_type);
int handle_at_recvfrom(enum at_cmd_type cmd_type);
int handle_at_poll(enum at_cmd_type cmd_type);
int handle_at_getaddrinfo(enum at_cmd_type cmd_type);

#if defined(CONFIG_SLM_NATIVE_TLS)
int handle_at_xcmng(enum at_cmd_type cmd_type);
#endif

/* ICMP commands */
int handle_at_icmp_ping(enum at_cmd_type cmd_type);

#if defined(CONFIG_SLM_SMS)
/* SMS commands */
int handle_at_sms(enum at_cmd_type cmd_type);
#endif

/* FOTA commands */
int handle_at_fota(enum at_cmd_type cmd_type);

#if defined(CONFIG_SLM_GNSS)
int handle_at_gps(enum at_cmd_type cmd_type);
int handle_at_gps_delete(enum at_cmd_type cmd_type);
#endif

#if defined(CONFIG_SLM_FTPC)
int handle_at_ftp(enum at_cmd_type cmd_type);
#endif
#if defined(CONFIG_SLM_TFTPC)
int handle_at_tftp(enum at_cmd_type cmd_type);
#endif

#if defined(CONFIG_SLM_MQTTC)
int handle_at_mqtt_config(enum at_cmd_type cmd_type);
int handle_at_mqtt_connect(enum at_cmd_type cmd_type);
int handle_at_mqtt_publish(enum at_cmd_type cmd_type);
int handle_at_mqtt_subscribe(enum at_cmd_type cmd_type);
int handle_at_mqtt_unsubscribe(enum at_cmd_type cmd_type);
#endif

#if defined(CONFIG_SLM_HTTPC)
int handle_at_httpc_connect(enum at_cmd_type cmd_type);
int handle_at_httpc_request(enum at_cmd_type cmd_type);
#endif

#if defined(CONFIG_SLM_TWI)
int handle_at_twi_list(enum at_cmd_type cmd_type);
int handle_at_twi_write(enum at_cmd_type cmd_type);
int handle_at_twi_read(enum at_cmd_type cmd_type);
int handle_at_twi_write_read(enum at_cmd_type cmd_type);
#endif

#if defined(CONFIG_SLM_GPIO)
int handle_at_gpio_configure(enum at_cmd_type cmd_type);
int handle_at_gpio_operate(enum at_cmd_type cmd_type);
#endif

static struct slm_at_cmd {
	const char *string;
	slm_at_handler_t handler;
} slm_at_cmd_list[] = {
	/* Generic commands */
	{"AT#XSLMVER", handle_at_slmver},
	{"AT#XSLEEP", handle_at_sleep},
	{"AT#XSHUTDOWN", handle_at_shutdown},
	{"AT#XRESET", handle_at_reset},
	{"AT#XMODEMRESET", handle_at_modemreset},
	{"AT#XUUID", handle_at_uuid},
	{"AT#XCLAC", handle_at_clac},
	{"AT#XDATACTRL", handle_at_datactrl},

	/* TCP proxy commands */
	{"AT#XTCPSVR", handle_at_tcp_server},
	{"AT#XTCPCLI", handle_at_tcp_client},
	{"AT#XTCPSEND", handle_at_tcp_send},
	{"AT#XTCPHANGUP", handle_at_tcp_hangup},

	/* UDP proxy commands */
	{"AT#XUDPSVR", handle_at_udp_server},
	{"AT#XUDPCLI", handle_at_udp_client},
	{"AT#XUDPSEND", handle_at_udp_send},

	/* Socket-type TCPIP commands */
	{"AT#XSOCKET", handle_at_socket},
	{"AT#XSSOCKET", handle_at_secure_socket},
	{"AT#XSOCKETSELECT", handle_at_socket_select},
	{"AT#XSOCKETOPT", handle_at_socketopt},
	{"AT#XSSOCKETOPT", handle_at_secure_socketopt},
	{"AT#XBIND", handle_at_bind},
	{"AT#XCONNECT", handle_at_connect},
	{"AT#XLISTEN", handle_at_listen},
	{"AT#XACCEPT", handle_at_accept},
	{"AT#XSEND", handle_at_send},
	{"AT#XRECV", handle_at_recv},
	{"AT#XSENDTO", handle_at_sendto},
	{"AT#XRECVFROM", handle_at_recvfrom},
	{"AT#XPOLL", handle_at_poll},
	{"AT#XGETADDRINFO", handle_at_getaddrinfo},

#if defined(CONFIG_SLM_NATIVE_TLS)
	{"AT#XCMNG", handle_at_xcmng},
#endif
	/* ICMP commands */
	{"AT#XPING", handle_at_icmp_ping},

#if defined(CONFIG_SLM_SMS)
	/* SMS commands */
	{"AT#XSMS", handle_at_sms},
#endif

	/* FOTA commands */
	{"AT#XFOTA", handle_at_fota},

#if defined(CONFIG_SLM_NRF_CLOUD)
	{"AT#XNRFCLOUD", handle_at_nrf_cloud},
#if defined(CONFIG_NRF_CLOUD_LOCATION)
	{"AT#XNRFCLOUDPOS", handle_at_nrf_cloud_pos},
#endif
#endif

#if defined(CONFIG_SLM_GNSS)
	/* GNSS commands */
	{"AT#XGPS", handle_at_gps},
	{"AT#XGPSDEL", handle_at_gps_delete},
#endif

#if defined(CONFIG_SLM_FTPC)
	/* FTP commands */
	{"AT#XFTP", handle_at_ftp},
#endif
#if defined(CONFIG_SLM_TFTPC)
	/* TFTP commands */
	{"AT#XTFTP", handle_at_tftp},
#endif

#if defined(CONFIG_SLM_MQTTC)
	{"AT#XMQTTCFG", handle_at_mqtt_config},
	{"AT#XMQTTCON", handle_at_mqtt_connect},
	{"AT#XMQTTPUB", handle_at_mqtt_publish},
	{"AT#XMQTTSUB", handle_at_mqtt_subscribe},
	{"AT#XMQTTUNSUB", handle_at_mqtt_unsubscribe},
#endif

#if defined(CONFIG_SLM_HTTPC)
	{"AT#XHTTPCCON", handle_at_httpc_connect},
	{"AT#XHTTPCREQ", handle_at_httpc_request},
#endif

#if defined(CONFIG_SLM_TWI)
	{"AT#XTWILS", handle_at_twi_list},
	{"AT#XTWIW", handle_at_twi_write},
	{"AT#XTWIR", handle_at_twi_read},
	{"AT#XTWIWR", handle_at_twi_write_read},
#endif

#if defined(CONFIG_SLM_GPIO)
	{"AT#XGPIOCFG", handle_at_gpio_configure},
	{"AT#XGPIO", handle_at_gpio_operate},
#endif

#if defined(CONFIG_SLM_CARRIER)
	{"AT#XCARRIER", handle_at_carrier},
#endif

#if defined(CONFIG_LWM2M_CARRIER_SETTINGS)
	{"AT#XCARRIERCFG", handle_at_carrier_cfg},
#endif

#if defined(CONFIG_SLM_PPP)
	{"AT#XPPP", handle_at_ppp},
#endif

#if defined(CONFIG_SLM_CMUX)
	{"AT#XCMUX", handle_at_cmux},
#endif
};

/* Handles AT#XCLAC command. */
int handle_at_clac(enum at_cmd_type cmd_type)
{
	int ret = -EINVAL;

	if (cmd_type == AT_CMD_TYPE_SET_COMMAND) {
		int total = ARRAY_SIZE(slm_at_cmd_list);

		for (int i = 0; i < total; i++) {
			rsp_send("%s\r\n", slm_at_cmd_list[i].string);
		}
		ret = 0;
	}

	return ret;
}

int slm_at_parse(const char *cmd_str, size_t cmd_name_len)
{
	int ret = UNKNOWN_AT_COMMAND_RET;
	int total = ARRAY_SIZE(slm_at_cmd_list);

	for (int i = 0; i < total; i++) {
		const struct slm_at_cmd *const at_cmd = &slm_at_cmd_list[i];

		/* For the match to happen the AT command names must be identical,
		 * which requires both names to have the same characters and the same length.
		 */
		if (!(!strncmp(cmd_str, at_cmd->string, cmd_name_len)
		      && at_cmd->string[cmd_name_len] == '\0')) {
			continue;
		}

		const enum at_cmd_type type = at_parser_cmd_type_get(cmd_str);

		at_params_list_clear(&slm_at_param_list);
		ret = at_parser_params_from_str(cmd_str, NULL, &slm_at_param_list);
		if (ret) {
			LOG_ERR("Failed to parse AT command %d", ret);
			return -EINVAL;
		}
		ret = at_cmd->handler(type);
		break;
	}

	return ret;
}

int slm_at_init(void)
{
	int err;

	k_work_init_delayable(&slm_work.sleep_work, go_sleep_wk);

	err = slm_at_tcp_proxy_init();
	if (err) {
		LOG_ERR("TCP Server could not be initialized: %d", err);
		return -EFAULT;
	}
	err = slm_at_udp_proxy_init();
	if (err) {
		LOG_ERR("UDP Server could not be initialized: %d", err);
		return -EFAULT;
	}
	err = slm_at_socket_init();
	if (err) {
		LOG_ERR("TCPIP could not be initialized: %d", err);
		return -EFAULT;
	}
	err = slm_at_icmp_init();
	if (err) {
		LOG_ERR("ICMP could not be initialized: %d", err);
		return -EFAULT;
	}
#if defined(CONFIG_SLM_SMS)
	err = slm_at_sms_init();
	if (err) {
		LOG_ERR("SMS could not be initialized: %d", err);
		return -EFAULT;
	}
#endif
	err = slm_at_fota_init();
	if (err) {
		LOG_ERR("FOTA could not be initialized: %d", err);
		return -EFAULT;
	}
#if defined(CONFIG_SLM_NRF_CLOUD)
	err = slm_at_nrfcloud_init();
	if (err) {
		LOG_ERR("nRF Cloud could not be initialized: %d", err);
		return -EFAULT;
	}
#endif
#if defined(CONFIG_SLM_GNSS)
	err = slm_at_gnss_init();
	if (err) {
		LOG_ERR("GNSS could not be initialized: %d", err);
		return -EFAULT;
	}
#endif
#if defined(CONFIG_SLM_FTPC)
	err = slm_at_ftp_init();
	if (err) {
		LOG_ERR("FTP could not be initialized: %d", err);
		return -EFAULT;
	}
#endif
#if defined(CONFIG_SLM_MQTTC)
	err = slm_at_mqtt_init();
	if (err) {
		LOG_ERR("MQTT could not be initialized: %d", err);
		return -EFAULT;
	}
#endif
#if defined(CONFIG_SLM_HTTPC)
	err = slm_at_httpc_init();
	if (err) {
		LOG_ERR("HTTP could not be initialized: %d", err);
		return -EFAULT;
	}
#endif
#if defined(CONFIG_SLM_GPIO)
	err = slm_at_gpio_init();
	if (err) {
		LOG_ERR("GPIO could not be initialized: %d", err);
		return -EFAULT;
	}
#endif
#if defined(CONFIG_SLM_TWI)
	err = slm_at_twi_init();
	if (err) {
		LOG_ERR("TWI could not be initialized: %d", err);
		return -EFAULT;
	}
#endif
#if defined(CONFIG_SLM_CARRIER)
	err = slm_at_carrier_init();
	if (err) {
		LOG_ERR("LwM2M carrier could not be initialized: %d", err);
		return -EFAULT;
	}
#endif
#if defined(CONFIG_SLM_CMUX)
	slm_cmux_init();
#endif
#if defined(CONFIG_SLM_PPP)
	err = slm_ppp_init();
	if (err) {
		LOG_ERR("PPP initialization failed. (%d)", err);
		return err;
	}
#endif
	return err;
}

void slm_at_uninit(void)
{
	int err;

	err = slm_at_tcp_proxy_uninit();
	if (err) {
		LOG_WRN("TCP Server could not be uninitialized: %d", err);
	}
	err = slm_at_udp_proxy_uninit();
	if (err) {
		LOG_WRN("UDP Server could not be uninitialized: %d", err);
	}
	err = slm_at_socket_uninit();
	if (err) {
		LOG_WRN("TCPIP could not be uninitialized: %d", err);
	}
	err = slm_at_icmp_uninit();
	if (err) {
		LOG_WRN("ICMP could not be uninitialized: %d", err);
	}
#if defined(CONFIG_SLM_SMS)
	err = slm_at_sms_uninit();
	if (err) {
		LOG_WRN("SMS could not be uninitialized: %d", err);
	}
#endif
	err = slm_at_fota_uninit();
	if (err) {
		LOG_WRN("FOTA could not be uninitialized: %d", err);
	}
#if defined(CONFIG_SLM_NRF_CLOUD)
	err = slm_at_nrfcloud_uninit();
	if (err) {
		LOG_WRN("nRF Cloud could not be uninitialized: %d", err);
	}
#endif
#if defined(CONFIG_SLM_GNSS)
	err = slm_at_gnss_uninit();
	if (err) {
		LOG_WRN("GNSS could not be uninitialized: %d", err);
	}
#endif
#if defined(CONFIG_SLM_FTPC)
	err = slm_at_ftp_uninit();
	if (err) {
		LOG_WRN("FTP could not be uninitialized: %d", err);
	}
#endif
#if defined(CONFIG_SLM_MQTTC)
	err = slm_at_mqtt_uninit();
	if (err) {
		LOG_WRN("MQTT could not be uninitialized: %d", err);
	}
#endif
#if defined(CONFIG_SLM_HTTPC)
	err = slm_at_httpc_uninit();
	if (err) {
		LOG_WRN("HTTP could not be uninitialized: %d", err);
	}
#endif
#if defined(CONFIG_SLM_TWI)
	err = slm_at_twi_uninit();
	if (err) {
		LOG_ERR("TWI could not be uninit: %d", err);
	}
#endif
#if defined(CONFIG_SLM_GPIO)
	err = slm_at_gpio_uninit();
	if (err) {
		LOG_ERR("GPIO could not be uninit: %d", err);
	}
#endif
#if defined(CONFIG_SLM_NRF52_DFU)
	err = slm_at_dfu_uninit();
	if (err) {
		LOG_ERR("DFU could not be uninitialized: %d", err);
	}
#endif
#if defined(CONFIG_SLM_CARRIER)
	err = slm_at_carrier_uninit();
	if (err) {
		LOG_ERR("LwM2M carrier could not be uninitialized: %d", err);
	}
#endif
}
```
